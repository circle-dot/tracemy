## firmware/nrf5x/boards/arm/nrf_dongle/Kconfig.defconfig
```kconfig
# Copyright (c) 2023 Nordic Semiconductor ASA
# SPDX-License-Identifier: Apache-2.0

if BOARD_NRF_DONGLE

config BOARD
	default "nrf_dongle"

config BT_CTLR
   default BT

endif
```
